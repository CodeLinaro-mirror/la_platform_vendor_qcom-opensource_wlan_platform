## cnss2/autogvm_consolidate_defconfig
```kconfig
CONFIG_CNSS_OUT_OF_TREE=y
CONFIG_CNSS2=m
CONFIG_CNSS2_QMI=y
CONFIG_CNSS_PLAT_IPC_QMI_SVC=m
CONFIG_CNSS2_DEBUG=y
CONFIG_CNSS2_ENUM_WITH_LOW_SPEED=y
CONFIG_CNSS2_CONDITIONAL_POWEROFF=y
CONFIG_CNSS_SUPPORT_DUAL_DEV=y
CONFIG_CNSS2_MHI_RDDM_TIMEOUT=1000000
```

## cnss2/autogvm_gki_defconfig
```kconfig
CONFIG_CNSS_OUT_OF_TREE=y
CONFIG_CNSS2=m
CONFIG_CNSS2_QMI=y
CONFIG_CNSS_PLAT_IPC_QMI_SVC=m
CONFIG_CNSS2_DEBUG=y
CONFIG_CNSS2_ENUM_WITH_LOW_SPEED=y
CONFIG_CNSS2_CONDITIONAL_POWEROFF=y
CONFIG_CNSS2_MHI_RDDM_TIMEOUT=1000000
CONFIG_WCNSS_MEM_PRE_ALLOC=m
CONFIG_AUTO_PROJECT=y
```

## cnss2_sdio/vienna-le_consolidate_defconfig
```kconfig
CONFIG_CNSS2_SDIO=m
CONFIG_CNSS_OUT_OF_TREE=y
CONFIG_WCNSS_MEM_PRE_ALLOC=m
CONFIG_CNSS2_DEBUG=y
CONFIG_SDIO_QCN=y
```

## cnss_prealloc/vienna_consolidate_defconfig
```kconfig
CONFIG_WCNSS_MEM_PRE_ALLOC=m
CONFIG_WCNSS_SKB_PRE_ALLOC=m
CONFIG_CNSS_OUT_OF_TREE=y
```

## qcn_sdio/Kconfig
```kconfig
config CNSS_OUT_OF_TREE
	bool "Enable Out of Tree Usage"
	help
	  If enabled, CNSS platform driver modules would be able to access
	  functions from the other modules in the platform driver.

config SDIO_QCN
	tristate "Qualcomm Technologies, Inc SDIO Function 1 Driver"
	default n
	help
	  This module adds the support for SDIO based Wi-Fi devices with QCN7605
	  chipsets. This module interfaces the diag, IPC router, Qsahara and
	  WLAN driver with the external sdio based soc.
```

## qti_sdio_client/Kconfig
```kconfig
config CNSS_OUT_OF_TREE
	bool "Enable Out of Tree Usage"
	help
	  If enabled, CNSS platform driver modules would be able to access
	  functions from the other modules in the platform driver.

config SDIO_QCN
	tristate "Qualcomm Technologies, Inc SDIO Function 1 Driver"
	default n
	help
	  This module adds the support for SDIO based Wi-Fi devices with QCN7605
	  chipsets. This module interfaces the diag, IPC router, Qsahara and
	  WLAN driver with the external sdio based soc.

config WCNSS_MEM_PRE_ALLOC
	tristate "WCNSS pre-alloc memory support"
	help
	  Pre-allocate memory for the WLAN driver module.
	  This feature enable cld wlan driver to use pre allocated memory
	  for it's internal usage and release it to back to pre allocated pool.
	  This memory is allocated at the cold boot time.
```
